## conf/layer.conf
```bitbake
# We have a conf and classes directory, add to BBPATH
BBPATH .= ":${LAYERDIR}"

# We have recipes-* directories, add to BBFILES
BBFILES += "${LAYERDIR}/recipes-*/*/*.bb \
            ${LAYERDIR}/recipes-*/*/*.bbappend"

BBFILE_COLLECTIONS += "kpmpower"
BBFILE_PATTERN_kpmpower = "^${LAYERDIR}/"
BBFILE_PRIORITY_kpmpower = "6"
LAYERVERSION_kpmpower = "1"
LAYERDEPENDS_kpmpower = "core"
LAYERSERIES_COMPAT_kpmpower = "mickledore nanbield"
```
